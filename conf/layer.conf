## conf/layer.conf
```bitbake
# We have a conf and classes directory, add to BBPATH
BBPATH .= ":${LAYERDIR}"

# We have recipes-* directories, add to BBFILES
BBFILES += "${LAYERDIR}/recipes-*/*/*.bb \
            ${LAYERDIR}/recipes-*/*/*.bbappend"

BBFILE_COLLECTIONS += "meta-ily"
BBFILE_PATTERN_meta-ily = "^${LAYERDIR}/"
BBFILE_PRIORITY_meta-ily = "6"

LAYERDEPENDS_meta-ily = "core"
LAYERSERIES_COMPAT_meta-ily = "kirkstone"
```
